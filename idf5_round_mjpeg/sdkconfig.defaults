## idf5_round_mjpeg/sdkconfig.defaults
```kconfig
CONFIG_IDF_TARGET="esp32s3"

# Match actual flash on the board (avoids the 8MB/16MB warning from the PIO path).
CONFIG_ESPTOOLPY_FLASHSIZE_16MB=y
CONFIG_ESPTOOLPY_FLASHSIZE="16MB"

# Upstream-like perf defaults.
CONFIG_COMPILER_OPTIMIZATION_PERF=y
CONFIG_ESP_DEFAULT_CPU_FREQ_MHZ_240=y
CONFIG_ESP_DEFAULT_CPU_FREQ_MHZ=240
CONFIG_FREERTOS_HZ=100

# RGB panel stability.
CONFIG_LCD_RGB_RESTART_IN_VSYNC=y

# ESP32-S3 OPI PSRAM configuration (board hardware).
CONFIG_ESP32S3_SPIRAM_SUPPORT=y
CONFIG_SPIRAM=y
CONFIG_SPIRAM_MODE_OCT=y
CONFIG_SPIRAM_TYPE_AUTO=y
CONFIG_SPIRAM_SPEED_80M=y
CONFIG_SPIRAM_BOOT_INIT=y
CONFIG_SPIRAM_USE_MALLOC=y
CONFIG_SPIRAM_MALLOC_ALWAYSINTERNAL=16384
CONFIG_SPIRAM_MALLOC_RESERVE_INTERNAL=32768
CONFIG_SPIRAM_ALLOW_STACK_EXTERNAL_MEMORY=y
CONFIG_SPIRAM_MEMTEST=y

# Try faster esp_jpeg path than ROM decoder (still blocking, but measurable).
# CONFIG_JD_USE_ROM is not set
CONFIG_JD_FASTDECODE_TABLE=y
CONFIG_JD_TBLCLIP=y
CONFIG_JD_USE_SCALE=y
CONFIG_JD_FORMAT_RGB565=y
```

## sdkconfig.defaults
```kconfig
CONFIG_IDF_TARGET="esp32s3"
CONFIG_ESPTOOLPY_FLASHSIZE_16MB=y
CONFIG_COMPILER_OPTIMIZATION_PERF=y
CONFIG_LCD_RGB_RESTART_IN_VSYNC=y
CONFIG_SPIRAM=y
CONFIG_SPIRAM_MODE_OCT=y
CONFIG_SPIRAM_SPEED_80M=y
CONFIG_ESP_DEFAULT_CPU_FREQ_MHZ_240=y
CONFIG_FREERTOS_HZ=1000
CONFIG_ESP_INSIGHTS_ENABLED=n
CONFIG_ARDUINO_SELECTIVE_COMPILATION=y
CONFIG_ARDUINO_SELECTIVE_FS=y
CONFIG_ARDUINO_SELECTIVE_SD_MMC=y
CONFIG_ARDUINO_SELECTIVE_Wire=y
CONFIG_AUTOSTART_ARDUINO=y
```
